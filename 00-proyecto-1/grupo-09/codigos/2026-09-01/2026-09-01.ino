//Bibliotecas que vamos a usar, es principalmente importante ya que con esta hacemos el llamado a la pantalla oled
#include <Wire.h>
#include <Adafruit_GFX.h>
#include <Adafruit_SSD1306.h>

// Pantalla OLED aquí declaramos la pantalla y sus características
#define SCREEN_WIDTH 128
#define SCREEN_HEIGHT 32
#define OLED_RESET -1
#define SCREEN_ADDRESS 0x3C

// Tipo de objeto 
Adafruit_SSD1306 display(SCREEN_WIDTH, SCREEN_HEIGHT, &Wire, OLED_RESET);

// Componentes, importante revisar que los pin estén correctos 
const int potenciometro = A0;
const int buttonPin = 12; // pushbutton pin
const int ledPin = 13;    // LED pin


// 4. DATOS VISUALES

// 'frames animacion_1', 128x32px
const unsigned char epd_bitmap_frames_animacion_1 [] PROGMEM = {
  0xff, 0xff, 0xff, 0xff, 0xff, 0xff, 0xff, 0xff, 0xff, 0xff, 0xff, 0xff, 0xff, 0xff, 0xff, 0xff, 
  0xff, 0xff, 0xff, 0xff, 0xff, 0xff, 0xff, 0xff, 0xff, 0xff, 0xff, 0xff, 0xff, 0xff, 0xff, 0xff, 
  0xff, 0xff, 0xff, 0xff, 0xff, 0xff, 0xff, 0xff, 0xff, 0xff, 0xff, 0xff, 0xff, 0xff, 0xff, 0xff, 
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  0xff, 0xff, 0xff, 0xff, 0xff, 0xff, 0xff, 0xff, 0xff, 0xff, 0xff, 0xff, 0xff, 0xff, 0xff, 0xfe
};


// 'frames animacion_2', 128x32px
const unsigned char epd_bitmap_frames_animacion_2 [] PROGMEM = {
  0xff, 0xff, 0xff, 0xff, 0xff, 0xff, 0x83, 0xff, 0xff, 0xff, 0xff, 0xff, 0xff, 0xff, 0xff, 0xff, 
  0xff, 0xff, 0xff, 0xff, 0xff, 0xff, 0xc1, 0xff, 0xff, 0xff, 0xff, 0xff, 0xff, 0xff, 0xff, 0xff, 
  0xff, 0xff, 0xff, 0xff, 0xff, 0xff, 0xc0, 0xff, 0xff, 0xff, 0xff, 0xff, 0xff, 0xff, 0xff, 0xff, 
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  0xff, 0xff, 0xff, 0xff, 0xff, 0xff, 0xff, 0xff, 0xff, 0xff, 0xff, 0xff, 0xff, 0xff, 0xff, 0xff
};


// 'frames animacion_3', 128x32px
const unsigned char epd_bitmap_frames_animacion_3 [] PROGMEM = {
  0xff, 0xff, 0xff, 0xff, 0xff, 0xff, 0xff, 0xff, 0xff, 0xff, 0xff, 0xff, 0xff, 0xff, 0xff, 0xff, 
  0xff, 0xff, 0xff, 0xff, 0xff, 0xff, 0xff, 0xff, 0xff, 0xff, 0xff, 0xff, 0xff, 0xff, 0xff, 0xff, 
  0xff, 0xff, 0xff, 0xff, 0xff, 0xff, 0xff, 0xff, 0xff, 0xff, 0xff, 0xff, 0xff, 0xff, 0xff, 0xff, 
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  0xff, 0xff, 0xff, 0xff, 0xff, 0xff, 0xff, 0xff, 0xf0, 0x3f, 0xff, 0xff, 0xff, 0xff, 0xff, 0xff
};


// 'frames animacion_4', 128x32px
const unsigned char epd_bitmap_frames_animacion_4 [] PROGMEM = {
  0xff, 0xff, 0xff, 0xff, 0xff, 0xff, 0xff, 0xff, 0xff, 0xff, 0xff, 0xff, 0xff, 0xff, 0xff, 0xff, 
  0xff, 0xff, 0xff, 0xff, 0xff, 0xff, 0xff, 0xff, 0xff, 0xff, 0xff, 0xff, 0xff, 0xff, 0xff, 0xff, 
  0xff, 0xff, 0xff, 0xff, 0xff, 0xff, 0xff, 0xff, 0xff, 0xff, 0xff, 0xff, 0xff, 0xff, 0xff, 0xff, 
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  0xff, 0xff, 0xff, 0xff, 0xff, 0xff, 0xff, 0xf8, 0x7f, 0xff, 0xff, 0xff, 0xff, 0xff, 0xef, 0xff
};


// 'frames animacion_5', 128x32px
const unsigned char epd_bitmap_frames_animacion_5 [] PROGMEM = {
  0xff, 0xff, 0xff, 0xff, 0xf8, 0x0f, 0xff, 0xff, 0xff, 0xff, 0xff, 0xff, 0xff, 0xff, 0xff, 0xff, 
  0xff, 0xff, 0xff, 0xff, 0xf8, 0x07, 0xff, 0xff, 0xff, 0xff, 0xff, 0xff, 0xff, 0xff, 0xff, 0xff, 
  0xff, 0xff, 0xff, 0xff, 0xfc, 0x07, 0xff, 0xff, 0xff, 0xff, 0xff, 0xff, 0xff, 0xff, 0xff, 0xff, 
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  0xff, 0xff, 0xff, 0xff, 0xff, 0xff, 0xff, 0xff, 0xff, 0xff, 0xff, 0xff, 0xff, 0xff, 0xff, 0x80
};


// 'frames animacion_6', 128x32px
const unsigned char epd_bitmap_frames_animacion_6 [] PROGMEM = {
  0xff, 0xff, 0xff, 0xff, 0xff, 0xff, 0xff, 0xff, 0xff, 0xff, 0xff, 0xff, 0xff, 0xff, 0xff, 0xff, 
  0xff, 0xff, 0xff, 0xff, 0xff, 0xff, 0xff, 0xff, 0xff, 0xff, 0xff, 0xff, 0xff, 0xff, 0xff, 0xff, 
  0xff, 0xff, 0xff, 0xff, 0xff, 0xff, 0xff, 0xff, 0xff, 0xff, 0xff, 0xff, 0xff, 0xff, 0xff, 0xff, 
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  0xff, 0xff, 0xff, 0xff, 0xff, 0xff, 0xff, 0x0f, 0xff, 0xff, 0xff, 0xff, 0xff, 0xff, 0xff, 0x1f
};


// Array que reúne los 6 frames
const int epd_bitmap_allArray_LEN = 6;

const unsigned char* epd_bitmap_allArray[6] = {
  epd_bitmap_frames_animacion_1,
  epd_bitmap_frames_animacion_2,
  epd_bitmap_frames_animacion_3,
  epd_bitmap_frames_animacion_4,
  epd_bitmap_frames_animacion_5,
  epd_bitmap_frames_animacion_6
};

// TEXTOS DEL PROYECTO 

const char* partesVersos[] = {

  // Verso 1
  "No tienes\nque ser buena.",

  // Verso 2 - parte 1
  "No tienes que\nrecorrer el\ndesierto de",

  // Verso 2 - parte 2
  "rodillas,\narrepintiendote.",

  // Verso 3 - parte 1
  "Solo deja que\nel suave animal",

  // Verso 3 - parte 2
  "de tu cuerpo\name lo que ama.",

  // Verso 4
  "Hablame del dolor,\ndel tuyo,\nyo te hablare del mio.",

  // Verso 5
  "Mientras tanto,\nel mundo sigue."
};



const char autora[] = "Mary Oliver";
const char titulo[] = "Gansos salvajes";
const char instruccionPot[] = "Gira potenciometro";


const char* licencia[] = {
  "Proyecto academico",
  "Fragmento de 'Wild Geese'",
  "por Mary Oliver",
  "Uso educativo no comercial",
  "Wild Geese, 1986",
  "Mary Oliver"
};

const char* mensajeBoton[] = {
  "Presiona boton",
  "para leer"
};

// 4. VARIABLES DE CONTROL

int etapa = 0; 
int buttonState = 0; 
int lastButtonState = 0; 
int versoActual = 0; 
int valorPot = 0; 
int letrasMostrar = 0;
unsigned long tiempoUltimoClick = 0; 
const unsigned long intervaloDobleClick = 400;

// 5. DECLARACION DE FUNCIONES

void mostrarLicencia();
void mostrarAnimacion();
void mostrarMensajeBoton();
void mostrarTitulo();
void mostrarVerso();
void mostrarAutora();
void revisarBoton();
void revisarDobleClick();
void reiniciarProyecto();

// 6. SETUP

void setup() {

  // Preparar componentes
  pinMode(buttonPin, INPUT);
  pinMode(ledPin, OUTPUT);

  // LED comienza apagado
  digitalWrite(ledPin, LOW);

  // Iniciar pantalla OLED
  if (!display.begin(SSD1306_SWITCHCAPVCC, SCREEN_ADDRESS)) {
    for (;;);
  }

  // Limpiar pantalla
  display.clearDisplay();
  display.display();

  // Comenzar desde el inicio
  etapa = 0;
}

void loop() {

  // ETAPA 0: licencia
  if (etapa == 0) {

    mostrarLicencia();
    etapa = 1;
  }


  // ETAPA 1: animacion
  else if (etapa == 1) {

    mostrarAnimacion();
    mostrarMensajeBoton();

    etapa = 2;
  }


  // ETAPAS 2, 3 y 4:
  // esperar presiones normales del boton
  else if (etapa >= 2 && etapa <= 4) {

    revisarBoton();
  }


  // ETAPA 5:
  // potenciometro + doble clic para reiniciar
  else if (etapa == 5) {

    mostrarAutora();
    revisarDobleClick();
  }
}

// 8. FUNCIONES


void mostrarLicencia() {

  // Primera parte
  display.clearDisplay();
  display.setTextSize(1);
  display.setTextColor(SSD1306_WHITE);

  display.setCursor(0, 0);
  display.println(licencia[0]);

  display.setCursor(0, 10);
  display.println(licencia[1]);

  display.setCursor(0, 20);
  display.println(licencia[2]);

  display.display();
  delay(2500);


  // Segunda parte
  display.clearDisplay();

  display.setCursor(0, 0);
  display.println(licencia[3]);

  display.setCursor(0, 10);
  display.println(licencia[4]);

  display.setCursor(0, 20);
  display.println(licencia[5]);

  display.display();
  delay(2500);


  // Limpiar al terminar
  display.clearDisplay();
  display.display();
}



void mostrarAnimacion() {

  for (int i = 0; i < epd_bitmap_allArray_LEN; i++) {

    display.clearDisplay();

    display.drawBitmap(
      0,
      0,
      epd_bitmap_allArray[i],
      SCREEN_WIDTH,
      SCREEN_HEIGHT,
      SSD1306_WHITE
    );

    display.display();

    delay(150);
  }
}



void mostrarMensajeBoton() {

  display.clearDisplay();
  display.setTextSize(1);
  display.setTextColor(SSD1306_WHITE);

  display.setCursor(10, 8);
  display.println(mensajeBoton[0]);

  display.setCursor(25, 18);
  display.println(mensajeBoton[1]);

  display.display();
}



void mostrarTitulo() {

  display.clearDisplay();
  display.setTextSize(1);
  display.setTextColor(SSD1306_WHITE);

  display.setCursor(20, 10);
  display.println(titulo);

  display.display();
}



void mostrarVerso() {

  // LED segun el verso
  if (versoActual % 2 == 0) {

    digitalWrite(ledPin, HIGH);   // versos 1, 3 y 5

  } else {

    digitalWrite(ledPin, LOW);    // versos 2 y 4
  }


  display.clearDisplay();
  display.setTextSize(1);
  display.setTextColor(SSD1306_WHITE);


  // VERSO 1
  if (versoActual == 0) {

    display.setCursor(0, 6);
    display.println(partesVersos[0]);
    display.display();
  }


  // VERSO 2
  else if (versoActual == 1) {

    // Parte 1
    display.setCursor(0, 0);
    display.println(partesVersos[1]);
    display.display();

    delay(2500);

    // Parte 2
    display.clearDisplay();
    display.setCursor(0, 6);
    display.println(partesVersos[2]);
    display.display();
  }


  // VERSO 3
  else if (versoActual == 2) {

    // Parte 1
    display.setCursor(0, 6);
    display.println(partesVersos[3]);
    display.display();

    delay(2500);

    // Parte 2
    display.clearDisplay();
    display.setCursor(0, 6);
    display.println(partesVersos[4]);
    display.display();
  }


  // VERSO 4
  else if (versoActual == 3) {

    display.setCursor(0, 0);
    display.println(partesVersos[5]);
    display.display();
  }


  // VERSO 5
  else if (versoActual == 4) {

    display.setCursor(0, 6);
    display.println(partesVersos[6]);
    display.display();
  }
}



void mostrarAutora() {

  // Leer potenciometro
  valorPot = analogRead(potenciometro);


  // Transformar el valor del potenciometro
  // en cantidad de letras visibles
  letrasMostrar = map(
    valorPot,
    0,
    1023,
    0,
    strlen(autora)
  );


  display.clearDisplay();
  display.setTextSize(1);
  display.setTextColor(SSD1306_WHITE);


  // Nombre de autora
  display.setCursor(0, 0);

  for (int i = 0; i < letrasMostrar; i++) {

    display.print(autora[i]);
  }


  // Instruccion abajo
  display.setCursor(0, 22);
  display.println(instruccionPot);


  display.display();
}



void revisarBoton() {

  // Leer boton
  buttonState = digitalRead(buttonPin);


  // Detectar una nueva presion
  if (buttonState == HIGH && lastButtonState == LOW) {

    // Antirrebote
    delay(30);


    // MENSAJE → TITULO
    if (etapa == 2) {

      mostrarTitulo();

      etapa = 3;
    }


    // TITULO → VERSO 1
    else if (etapa == 3) {

      versoActual = 0;

      mostrarVerso();

      etapa = 4;
    }


    // AVANZAR ENTRE VERSOS
    else if (etapa == 4) {

      // Si quedan versos
      if (versoActual < 4) {

        versoActual++;

        mostrarVerso();
      }


      // Si termino el verso 5
      else {

        digitalWrite(ledPin, LOW);

        etapa = 5;
      }
    }
  }


  // Guardar estado anterior del boton
  lastButtonState = buttonState;
}



void revisarDobleClick() {

  buttonState = digitalRead(buttonPin);


  // Detectar nueva presion
  if (buttonState == HIGH && lastButtonState == LOW) {

    unsigned long tiempoActual = millis();


    // Segundo clic dentro del intervalo
    if (
      tiempoUltimoClick > 0 &&
      tiempoActual - tiempoUltimoClick <= intervaloDobleClick
    ) {

      reiniciarProyecto();

      tiempoUltimoClick = 0;
    }


    // Primer clic
    else {

      tiempoUltimoClick = tiempoActual;
    }
  }


  // Guardar estado anterior del boton
  lastButtonState = buttonState;
}



void reiniciarProyecto() {

  // Volver al inicio
  etapa = 0;


  // Volver al primer verso
  versoActual = 0;


  // Apagar LED
  digitalWrite(ledPin, LOW);


  // Reiniciar potenciometro y autora
  valorPot = 0;
  letrasMostrar = 0;


  // Reiniciar doble clic
  tiempoUltimoClick = 0;


  // Actualizar estado del boton
  buttonState = digitalRead(buttonPin);
  lastButtonState = buttonState;


  // Limpiar pantalla
  display.clearDisplay();
  display.display();
}
