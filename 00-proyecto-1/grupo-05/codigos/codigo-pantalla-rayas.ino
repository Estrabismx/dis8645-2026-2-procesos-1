/*
  ============================================================
   Animación de caballo corriendo - OLED 128x32 I2C
   Arduino Uno R4 WiFi
   (Sin potenciómetro - movimiento automático)
  ============================================================
*/


#include <Wire.h>
#include <Adafruit_GFX.h>
#include <Adafruit_SSD1306.h>


// ----------------- Configuración de la pantalla -----------------
#define SCREEN_WIDTH   128
#define SCREEN_HEIGHT  32
#define OLED_RESET     -1
#define SCREEN_ADDRESS 0x3C


Adafruit_SSD1306 display(SCREEN_WIDTH, SCREEN_HEIGHT, &Wire, OLED_RESET);


// ----------------- Configuración de la animación (frames) -----------------
unsigned long frameInterval = 100;       // ms entre cambio de pata (ajustable)
unsigned long previousFrameMillis = 0;
uint8_t currentFrame = 0;
const uint8_t TOTAL_FRAMES = 4;


// ----------------- Configuración del movimiento horizontal -----------------
unsigned long moveInterval = 20;         // ms entre cada paso de desplazamiento (ajustable)
unsigned long previousMoveMillis = 0;
int xPos = -128;                         // posición inicial: fuera de pantalla a la izquierda
const int xStep = 2;                     // píxeles que avanza en cada paso (ajustable: velocidad)


// ----------------- Bitmaps de la animación (128x32) -----------------


// fotograma1  128 x 32  (mono, SSD1306 vertical pages, LSB=top)
const int fotograma1_width  = 128;
const int fotograma1_height = 32;
const unsigned char fotograma1[] PROGMEM = {
  0x00, 0x00, 0x00, 0x00, 0x00, 0x00, 0x00, 0x00, 0x00, 0x00, 0x00, 0x00, 0x00, 0x00, 0x00, 0x00,
  0x00, 0x00, 0x00, 0x00, 0x00, 0x00, 0x00, 0x00, 0x00, 0x00, 0x00, 0x00, 0x00, 0x00, 0x00, 0x00,
  0x00, 0x00, 0x00, 0x00, 0x00, 0x00, 0x00, 0x00, 0x00, 0x00, 0x00, 0x00, 0x00, 0x00, 0x00, 0x00,
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  0x00, 0x00, 0x00, 0x00, 0x00, 0x00, 0x00, 0x00, 0x00, 0x00, 0x00, 0x00, 0x00, 0x00, 0x00, 0x00
};


// fotograma2  128 x 32  (mono, SSD1306 vertical pages, LSB=top)
const int fotograma2_width  = 128;
const int fotograma2_height = 32;
const unsigned char fotograma2[] PROGMEM = {
  0x00, 0x00, 0x00, 0x00, 0x00, 0x00, 0x00, 0x00, 0x00, 0x00, 0x00, 0x00, 0x00, 0x00, 0x00, 0x00,
  0x00, 0x00, 0x00, 0x00, 0x00, 0x00, 0x00, 0x00, 0x00, 0x00, 0x00, 0x00, 0x00, 0x00, 0x00, 0x00,
  0x00, 0x00, 0x00, 0x00, 0x00, 0x00, 0x00, 0x00, 0x00, 0x00, 0x00, 0x00, 0x00, 0x00, 0x00, 0x00,
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  0x00, 0x00, 0x00, 0x00, 0x00, 0x00, 0x00, 0x00, 0x00, 0x00, 0x00, 0x00, 0x00, 0x00, 0x00, 0x00
};


// fotograma3  128 x 32  (mono, SSD1306 vertical pages, LSB=top)
const int fotograma3_width  = 128;
const int fotograma3_height = 32;
const unsigned char fotograma3[] PROGMEM = {
  0x00, 0x00, 0x00, 0x00, 0x00, 0x00, 0x00, 0x00, 0x00, 0x00, 0x00, 0x00, 0x00, 0x00, 0x00, 0x00,
  0x00, 0x00, 0x00, 0x00, 0x00, 0x00, 0x00, 0x00, 0x00, 0x00, 0x00, 0x00, 0x00, 0x00, 0x00, 0x00,
  0x00, 0x00, 0x00, 0x00, 0x00, 0x00, 0x00, 0x00, 0x00, 0x00, 0x00, 0x00, 0x00, 0x00, 0x00, 0x00,
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  0x00, 0x00, 0x00, 0x00, 0x00, 0x00, 0x00, 0x00, 0x00, 0x00, 0x00, 0x00, 0x00, 0x00, 0x00, 0x00
};


// fotograma4  128 x 32  (mono, SSD1306 vertical pages, LSB=top)
const int fotograma4_width  = 128;
const int fotograma4_height = 32;
const unsigned char fotograma4[] PROGMEM = {
  0x00, 0x00, 0x00, 0x00, 0x00, 0x00, 0x00, 0x00, 0x00, 0x00, 0x00, 0x00, 0x00, 0x00, 0x00, 0x00,
  0x00, 0x00, 0x00, 0x00, 0x00, 0x00, 0x00, 0x00, 0x00, 0x00, 0x00, 0x00, 0x00, 0x00, 0x00, 0x00,
  0x00, 0x00, 0x00, 0x00, 0x00, 0x00, 0x00, 0x00, 0x00, 0x00, 0x00, 0x00, 0x00, 0x00, 0x00, 0x00,
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  0x00, 0x00, 0x00, 0x00, 0x00, 0x00, 0x00, 0x00, 0x00, 0x00, 0x00, 0x00, 0x00, 0x00, 0x00, 0x00
};


// Array de punteros para recorrer los frames fácilmente en el ciclo
const unsigned char* const animationFrames[TOTAL_FRAMES] = {
  fotograma1, fotograma2, fotograma3, fotograma4
};


// ----------------- Setup -----------------
void setup() {
  Serial.begin(115200);


  if (!display.begin(SSD1306_SWITCHCAPVCC, SCREEN_ADDRESS)) {
    Serial.println(F("Error: no se pudo inicializar la pantalla SSD1306"));
    while (true) {
      // Detener ejecución si falla la pantalla
    }
  }


  display.clearDisplay();
  display.display();
}


// ----------------- Loop -----------------
void loop() {
  unsigned long currentMillis = millis();


  // ---------- 1. Actualizar el frame de animación (patas) ----------
  if (currentMillis - previousFrameMillis >= frameInterval) {
    previousFrameMillis = currentMillis;
    currentFrame = (currentFrame + 1) % TOTAL_FRAMES;
  }


  // ---------- 2. Actualizar posición horizontal ----------
  if (currentMillis - previousMoveMillis >= moveInterval) {
    previousMoveMillis = currentMillis;
    xPos += xStep;
    if (xPos > 128) {          // salió completamente por la derecha
      xPos = -128;             // reaparece por la izquierda
    }
  }


  // ---------- 3. Dibujar en pantalla ----------
  display.clearDisplay();
  display.drawBitmap(xPos, 0, animationFrames[currentFrame],
                      SCREEN_WIDTH, SCREEN_HEIGHT, SSD1306_WHITE);
  display.display();
}

