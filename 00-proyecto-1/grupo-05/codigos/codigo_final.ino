#include <SPI.h>
#include <Wire.h>
#include <Adafruit_GFX.h>
#include <Adafruit_SSD1306.h>

#define SCREEN_WIDTH 128
#define SCREEN_HEIGHT 32

#define OLED_RESET     -1
#define SCREEN_ADDRESS 0x3C
Adafruit_SSD1306 display(SCREEN_WIDTH, SCREEN_HEIGHT, &Wire, OLED_RESET);

#define POT_PIN A0
#define BUTTON_PIN 2

// Reemplaza cada línea con un verso de tu poema
const char* frases[] = {
  "Extracto poema Romance de la luna, luna.", // 0
  "Federico Garcia Lorca.",                  // 1
  "Huye luna, luna, luna.",                  // 2 (Animación Luna)
  "Si vinieran los gitanos,",                // 3
  "harian con tu corazon",                   // 4 (Animación Corazón)
  "collares y anillos blancos.",             // 5
  "Nino, dejame que baile.",                 // 6
  "Cuando vengan los gitanos,",              // 7
  "te encontraran sobre el yunque",          // 8
  "con los ojillos cerrados.",               // 9 (Animación Ojo)
  "Huye luna, luna, luna,",                  // 10 (Animación Luna)
  "que ya siento sus caballos.",             // 11 (Animación Caballo)
  "Nino, dejame, no pises",                  // 12
  "mi blancor almidonado."                   // 13
};

const int cantidadFrases = sizeof(frases) / sizeof(frases[0]);
int fraseActual = 0;

int16_t textWidth, textHeight;
int minX;
bool botonPresionadoAntes = false;

// --- Variables para el control relativo del potenciómetro ---
float xPos = 0;          // Posición actual del texto (persistente entre frases)
int potAnterior = 0;     // Última lectura del potenciómetro, para calcular el delta

// --- Variables y configuraciones de las Animaciones ---
unsigned long frameInterval = 100;       // ms entre cambio de fotograma (dinámico)
unsigned long previousFrameMillis = 0;
uint8_t currentFrame = 0;

// Las animaciones comparten las mismas dimensiones
const int ANIM_WIDTH  = 128;
const int ANIM_HEIGHT = 32;
const int xOffsetCentered = (SCREEN_WIDTH  - ANIM_WIDTH)  / 2;
const int yOffset = (SCREEN_HEIGHT - ANIM_HEIGHT) / 2;

// --- Variables de movimiento para el Caballo ---
unsigned long previousMoveMillis = 0;
int xPosCaballo = -128;  // posición inicial: fuera de pantalla a la izquierda
const int xStep = 2;     // píxeles que avanza en cada paso

// Variable para controlar el estado (Texto o Animación)
bool mostrandoAnimacion = false;

// ============================================================
// Bitmaps de la animación de la LUNA (3 frames)
// ============================================================
const unsigned char fotograma1luna[] PROGMEM = {
  0x00, 0x00, 0x00, 0x00, 0x00, 0x00, 0x00, 0x00, 0x00, 0x00, 0x00, 0x00, 0x00, 0x00, 0x00, 0x00,
  0x00, 0x00, 0x00, 0x00, 0x00, 0x00, 0x00, 0x00, 0x00, 0x00, 0x00, 0x00, 0x00, 0x00, 0x00, 0x00,
  0x00, 0x00, 0x00, 0x00, 0x00, 0x00, 0x00, 0x00, 0x00, 0x00, 0x00, 0x00, 0x00, 0x00, 0x00, 0x00,
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  0x00, 0x00, 0x00, 0x00, 0x00, 0x00, 0x00, 0x00, 0x00, 0x00, 0x00, 0x00, 0x00, 0x00, 0x00, 0x00
};
const unsigned char fotograma2luna[] PROGMEM = {
  0x00, 0x00, 0x00, 0x00, 0x00, 0x00, 0x00, 0x00, 0x00, 0x00, 0x00, 0x00, 0x00, 0x00, 0x00, 0x00,
  0x00, 0x00, 0x00, 0x00, 0x00, 0x00, 0x00, 0x00, 0x00, 0x00, 0x00, 0x00, 0x00, 0x00, 0x00, 0x00,
  0x00, 0x00, 0x00, 0x00, 0x00, 0x00, 0x00, 0x00, 0x00, 0x00, 0x00, 0x00, 0x00, 0x00, 0x00, 0x00,
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  0x00, 0x00, 0x00, 0x00, 0x00, 0x00, 0x00, 0x00, 0x00, 0x00, 0x00, 0x00, 0x00, 0x00, 0x00, 0x00
};
const unsigned char fotograma3luna[] PROGMEM = {
  0x00, 0x00, 0x00, 0x00, 0x00, 0x00, 0x00, 0x00, 0x00, 0x00, 0x00, 0x00, 0x00, 0x00, 0x00, 0x00,
  0x00, 0x00, 0x00, 0x00, 0x00, 0x00, 0x00, 0x00, 0x00, 0x00, 0x00, 0x00, 0x00, 0x00, 0x00, 0x00,
  0x00, 0x00, 0x00, 0x00, 0x00, 0x00, 0x00, 0x00, 0x00, 0x00, 0x00, 0x00, 0x00, 0x00, 0x00, 0x00,
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  0x00, 0x00, 0x00, 0x00, 0x00, 0x00, 0x00, 0x00, 0x00, 0x00, 0x00, 0x00, 0x00, 0x00, 0x00, 0x00
};
const unsigned char* const animationFramesLuna[3] = {
  fotograma1luna, fotograma2luna, fotograma3luna
};

// ============================================================
// Bitmaps de la animación del CORAZÓN (3 frames)
// ============================================================
const unsigned char fotograma1corazon[] PROGMEM = {
  0x00, 0x00, 0x00, 0x00, 0x00, 0x00, 0x00, 0x00, 0x00, 0x00, 0x00, 0x00, 0x00, 0x00, 0x00, 0x00,
  0x00, 0x00, 0x00, 0x00, 0x00, 0x00, 0x00, 0x00, 0x00, 0x00, 0x00, 0x00, 0x00, 0x00, 0x00, 0x00,
  0x00, 0x00, 0x00, 0x00, 0x00, 0x00, 0x00, 0x00, 0x00, 0x00, 0x00, 0x00, 0x00, 0x00, 0x00, 0x00,
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  0x00, 0x00, 0x00, 0x00, 0x00, 0x00, 0x00, 0x00, 0x00, 0x00, 0x00, 0x00, 0x00, 0x00, 0x00, 0x00
};
const unsigned char fotograma2corazon[] PROGMEM = {
  0x00, 0x00, 0x00, 0x00, 0x00, 0x00, 0x00, 0x00, 0x00, 0x00, 0x00, 0x00, 0x00, 0x00, 0x00, 0x00,
  0x00, 0x00, 0x00, 0x00, 0x00, 0x00, 0x00, 0x00, 0x00, 0x00, 0x00, 0x00, 0x00, 0x00, 0x00, 0x00,
  0x00, 0x00, 0x00, 0x00, 0x00, 0x00, 0x00, 0x00, 0x00, 0x00, 0x00, 0x00, 0x00, 0x00, 0x00, 0x00,
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  0x00, 0x00, 0x00, 0x00, 0x00, 0x00, 0x00, 0x00, 0x00, 0x00, 0x00, 0x00, 0x00, 0x00, 0x00, 0x00
};
const unsigned char fotograma3corazon[] PROGMEM = {
  0x00, 0x00, 0x00, 0x00, 0x00, 0x00, 0x00, 0x00, 0x00, 0x00, 0x00, 0x00, 0x00, 0x00, 0x00, 0x00,
  0x00, 0x00, 0x00, 0x00, 0x00, 0x00, 0x00, 0x00, 0x00, 0x00, 0x00, 0x00, 0x00, 0x00, 0x00, 0x00,
  0x00, 0x00, 0x00, 0x00, 0x00, 0x00, 0x00, 0x00, 0x00, 0x00, 0x00, 0x00, 0x00, 0x00, 0x00, 0x00,
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  0x00, 0x00, 0x00, 0x00, 0x00, 0x00, 0x00, 0x00, 0x00, 0x00, 0x00, 0x00, 0x00, 0x00, 0x00, 0x00
};
const unsigned char* const animationFramesCorazon[3] = {
  fotograma1corazon, fotograma2corazon, fotograma3corazon
};

// ============================================================
// Bitmaps de la animación del OJO (3 frames)
// ============================================================
const unsigned char fotograma1ojo[] PROGMEM = {
  0x00, 0x00, 0x00, 0x00, 0x00, 0x00, 0x00, 0x00, 0x00, 0x00, 0x00, 0x00, 0x00, 0x00, 0x00, 0x00,
  0x00, 0x00, 0x00, 0x00, 0x00, 0x00, 0x00, 0x00, 0x00, 0x00, 0x00, 0x00, 0x00, 0x00, 0x00, 0x00,
  0x00, 0x00, 0x00, 0x00, 0x00, 0x00, 0x00, 0x00, 0x00, 0x00, 0x00, 0x00, 0x00, 0x00, 0x00, 0x00,
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  0x00, 0x00, 0x00, 0x00, 0x00, 0x00, 0x00, 0x00, 0x00, 0x00, 0x00, 0x00, 0x00, 0x00, 0x00, 0x00
};
const unsigned char fotograma2ojo[] PROGMEM = {
  0x00, 0x00, 0x00, 0x00, 0x00, 0x00, 0x00, 0x00, 0x00, 0x00, 0x00, 0x00, 0x00, 0x00, 0x00, 0x00,
  0x00, 0x00, 0x00, 0x00, 0x00, 0x00, 0x00, 0x00, 0x00, 0x00, 0x00, 0x00, 0x00, 0x00, 0x00, 0x00,
  0x00, 0x00, 0x00, 0x00, 0x00, 0x00, 0x00, 0x00, 0x00, 0x00, 0x00, 0x00, 0x00, 0x00, 0x00, 0x00,
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  0x00, 0x00, 0x00, 0x00, 0x00, 0x00, 0x00, 0x00, 0x00, 0x00, 0x00, 0x00, 0x00, 0x00, 0x00, 0x00
};
const unsigned char fotograma3ojo[] PROGMEM = {
  0x00, 0x00, 0x00, 0x00, 0x00, 0x00, 0x00, 0x00, 0x00, 0x00, 0x00, 0x00, 0x00, 0x00, 0x00, 0x00,
  0x00, 0x00, 0x00, 0x00, 0x00, 0x00, 0x00, 0x00, 0x00, 0x00, 0x00, 0x00, 0x00, 0x00, 0x00, 0x00,
  0x00, 0x00, 0x00, 0x00, 0x00, 0x00, 0x00, 0x00, 0x00, 0x00, 0x00, 0x00, 0x00, 0x00, 0x00, 0x00,
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  0x00, 0x00, 0x00, 0x00, 0x00, 0x00, 0x00, 0x00, 0x00, 0x00, 0x00, 0x00, 0x00, 0x00, 0x00, 0x00
};
const unsigned char* const animationFramesOjo[3] = {
  fotograma1ojo, fotograma2ojo, fotograma3ojo
};

// ============================================================
// Bitmaps de la animación del CABALLO (4 frames)
// ============================================================
const unsigned char fotograma1caballo[] PROGMEM = {
  0x00, 0x00, 0x00, 0x00, 0x00, 0x00, 0x00, 0x00, 0x00, 0x00, 0x00, 0x00, 0x00, 0x00, 0x00, 0x00,
  0x00, 0x00, 0x00, 0x00, 0x00, 0x00, 0x00, 0x00, 0x00, 0x00, 0x00, 0x00, 0x00, 0x00, 0x00, 0x00,
  0x00, 0x00, 0x00, 0x00, 0x00, 0x00, 0x00, 0x00, 0x00, 0x00, 0x00, 0x00, 0x00, 0x00, 0x00, 0x00,
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  0x00, 0x00, 0x00, 0x00, 0x00, 0x00, 0x00, 0x00, 0x00, 0x00, 0x00, 0x00, 0x00, 0x00, 0x00, 0x00
};
const unsigned char fotograma2caballo[] PROGMEM = {
  0x00, 0x00, 0x00, 0x00, 0x00, 0x00, 0x00, 0x00, 0x00, 0x00, 0x00, 0x00, 0x00, 0x00, 0x00, 0x00,
  0x00, 0x00, 0x00, 0x00, 0x00, 0x00, 0x00, 0x00, 0x00, 0x00, 0x00, 0x00, 0x00, 0x00, 0x00, 0x00,
  0x00, 0x00, 0x00, 0x00, 0x00, 0x00, 0x00, 0x00, 0x00, 0x00, 0x00, 0x00, 0x00, 0x00, 0x00, 0x00,
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  0x00, 0x00, 0x00, 0x00, 0x00, 0x00, 0x00, 0x00, 0x00, 0x00, 0x00, 0x00, 0x00, 0x00, 0x00, 0x00
};
const unsigned char fotograma3caballo[] PROGMEM = {
  0x00, 0x00, 0x00, 0x00, 0x00, 0x00, 0x00, 0x00, 0x00, 0x00, 0x00, 0x00, 0x00, 0x00, 0x00, 0x00,
  0x00, 0x00, 0x00, 0x00, 0x00, 0x00, 0x00, 0x00, 0x00, 0x00, 0x00, 0x00, 0x00, 0x00, 0x00, 0x00,
  0x00, 0x00, 0x00, 0x00, 0x00, 0x00, 0x00, 0x00, 0x00, 0x00, 0x00, 0x00, 0x00, 0x00, 0x00, 0x00,
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  0x00, 0x00, 0x00, 0x00, 0x00, 0x00, 0x00, 0x00, 0x00, 0x00, 0x00, 0x00, 0x00, 0x00, 0x00, 0x00
};
const unsigned char fotograma4caballo[] PROGMEM = {
  0x00, 0x00, 0x00, 0x00, 0x00, 0x00, 0x00, 0x00, 0x00, 0x00, 0x00, 0x00, 0x00, 0x00, 0x00, 0x00,
  0x00, 0x00, 0x00, 0x00, 0x00, 0x00, 0x00, 0x00, 0x00, 0x00, 0x00, 0x00, 0x00, 0x00, 0x00, 0x00,
  0x00, 0x00, 0x00, 0x00, 0x00, 0x00, 0x00, 0x00, 0x00, 0x00, 0x00, 0x00, 0x00, 0x00, 0x00, 0x00,
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  0x00, 0x00, 0x00, 0x00, 0x00, 0x00, 0x00, 0x00, 0x00, 0x00, 0x00, 0x00, 0x00, 0x00, 0x00, 0x00
};
const unsigned char* const animationFramesCaballo[4] = {
  fotograma1caballo, fotograma2caballo, fotograma3caballo, fotograma4caballo
};

// ============================================================
//  Función para dibujar un bitmap en formato "página SSD1306"
//  Soporta desplazamiento y se corta automáticamente en los bordes.
// ============================================================
void drawPageBitmap(const uint8_t* bitmap, int bmpWidth, int bmpHeight, int xPos, int yPos) {
  uint8_t pages = bmpHeight / 8;
  for (uint8_t page = 0; page < pages; page++) {
    for (int col = 0; col < bmpWidth; col++) {
      uint8_t byteData = pgm_read_byte(&bitmap[page * bmpWidth + col]);
      if (byteData == 0) continue; // optimización: columna vacía

      int screenX = col + xPos;
      if (screenX < 0 || screenX >= SCREEN_WIDTH) continue; // no dibuja fuera de pantalla

      for (uint8_t bit = 0; bit < 8; bit++) {
        if (byteData & (1 << bit)) {
          int screenY = page * 8 + bit + yPos;
          if (screenY < 0 || screenY >= SCREEN_HEIGHT) continue;
          display.drawPixel(screenX, screenY, SSD1306_WHITE);
        }
      }
    }
  }
}

// ============================================================
// Funciones del código base
// ============================================================
void actualizarMedidasTexto() {
  int16_t x1, y1;
  display.getTextBounds(frases[fraseActual], 0, 0, &x1, &y1, (uint16_t*)&textWidth, (uint16_t*)&textHeight);
  minX = SCREEN_WIDTH - textWidth;
  if (minX > 0) minX = 0;

  xPos = 0; // Cada vez que cambia la frase, la posición vuelve al inicio

  Serial.print("Frase (");
  Serial.print(fraseActual + 1);
  Serial.print("/");
  Serial.print(cantidadFrases);
  Serial.print("): ");
  Serial.println(frases[fraseActual]);
}

void setup() {
  Serial.begin(115200);
  pinMode(BUTTON_PIN, INPUT_PULLUP);

  delay(500);

  if (!display.begin(SSD1306_SWITCHCAPVCC, SCREEN_ADDRESS)) {
    Serial.println(F("SSD1306 allocation failed"));
    for (;;);
  }

  display.display();
  delay(1000);
  display.clearDisplay();

  display.setTextSize(2);
  display.setTextColor(SSD1306_WHITE);
  display.setTextWrap(false);

  potAnterior = analogRead(POT_PIN);
  actualizarMedidasTexto();
}

void loop() {
  bool botonPresionadoAhora = (digitalRead(BUTTON_PIN) == LOW);

  // ---------- Control del botón y cambio de estado ----------
  if (botonPresionadoAhora && !botonPresionadoAntes) {
    
    if (mostrandoAnimacion) {
      // 1. Si la animación se está reproduciendo, la detenemos
      // y pasamos manualmente a la siguiente frase.
      mostrandoAnimacion = false;
      fraseActual = (fraseActual + 1) % cantidadFrases;
      actualizarMedidasTexto();
      
    } else {
      // 2. Si estamos mostrando texto, verificamos si es una de las frases 
      // que detonan las animaciones
      if (fraseActual == 2 || fraseActual == 10 || fraseActual == 4 || fraseActual == 9 || fraseActual == 11) {
        mostrandoAnimacion = true; // Activar animación
        currentFrame = 0; // Resetear fotograma al iniciar nueva animación
        
        // Ajustamos la configuración dependiendo de cuál animación toca
        if (fraseActual == 9) {
          // Ojo
          frameInterval = 400; // Parpadeo lento
        } else if (fraseActual == 11) {
          // Caballo
          frameInterval = 100;
          xPosCaballo = -128;  // Al iniciar el caballo, siempre lo ponemos a la izquierda
        } else {
          // Luna y corazón
          frameInterval = 100;
        }
      } else {
        // Avance normal de texto para cualquier otra frase.
        fraseActual = (fraseActual + 1) % cantidadFrases;
        actualizarMedidasTexto();
      }
    }
    
    delay(200); // Antirrebote del botón
    potAnterior = analogRead(POT_PIN); // Actualizamos la ref del potenciómetro
  }
  
  botonPresionadoAntes = botonPresionadoAhora;

  // ---------- Dibujado en la pantalla ----------
  display.clearDisplay();

  if (mostrandoAnimacion) {
    // 1. Elegimos cuántos frames tiene esta animación
    uint8_t totalFrames = (fraseActual == 11) ? 4 : 3;

    // 2. Actualizamos el frame de la animación continuamente
    unsigned long currentMillis = millis();
    if (currentMillis - previousFrameMillis >= frameInterval) {
      previousFrameMillis = currentMillis;
      currentFrame = (currentFrame + 1) % totalFrames;
    }

    // 3. Elegimos qué animación mostrar y calcular posiciones
    if (fraseActual == 4) {
      // Corazón
      drawPageBitmap(animationFramesCorazon[currentFrame], ANIM_WIDTH, ANIM_HEIGHT, xOffsetCentered, yOffset);
    } else if (fraseActual == 9) {
      // Ojo
      drawPageBitmap(animationFramesOjo[currentFrame], ANIM_WIDTH, ANIM_HEIGHT, xOffsetCentered, yOffset);
    } else if (fraseActual == 11) {
      // Caballo (incluye lógica de movimiento)
      if (currentMillis - previousMoveMillis >= 20) { // moveInterval = 20
        previousMoveMillis = currentMillis;
        xPosCaballo += xStep;
        if (xPosCaballo > 128) {
          xPosCaballo = -128;
        }
      }
      drawPageBitmap(animationFramesCaballo[currentFrame], ANIM_WIDTH, ANIM_HEIGHT, xPosCaballo, yOffset);
    } else {
      // Luna (frases 2 y 10)
      drawPageBitmap(animationFramesLuna[currentFrame], ANIM_WIDTH, ANIM_HEIGHT, xOffsetCentered, yOffset);
    }
    
  } else {
    // Dibuja el texto que scrollea con el potenciómetro
    int potValue = analogRead(POT_PIN);
    int deltaPot = potValue - potAnterior;
    potAnterior = potValue;

    if (minX != 0) {
      float deltaPix = (float)deltaPot * minX / 1023.0;
      xPos += deltaPix;
    }

    if (xPos < minX) xPos = minX;
    if (xPos > 0) xPos = 0;

    int yPos = (SCREEN_HEIGHT - textHeight) / 2;
    display.setTextWrap(false);
    display.setCursor((int)xPos, yPos);
    display.print(frases[fraseActual]);
  }

  display.display();
  delay(20);
}