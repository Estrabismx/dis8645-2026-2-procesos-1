
/*
  ============================================================
   Animación de corazón - OLED 128x32 I2C
   Arduino Uno R4 WiFi
   (Imagen estática y centrada, solo cambia de fotograma)
  ============================================================
*/


#include <Wire.h>
#include <Adafruit_GFX.h>
#include <Adafruit_SSD1306.h>


// ----------------- Configuración de la pantalla -----------------
#define SCREEN_WIDTH   128
#define SCREEN_HEIGHT  32
#define OLED_RESET     -1
#define SCREEN_ADDRESS 0x3C


Adafruit_SSD1306 display(SCREEN_WIDTH, SCREEN_HEIGHT, &Wire, OLED_RESET);


// ----------------- Configuración de la animación (frames) -----------------
unsigned long frameInterval = 100;       // ms entre cambio de fotograma (ajustable)
unsigned long previousFrameMillis = 0;
uint8_t currentFrame = 0;
const uint8_t TOTAL_FRAMES = 3;


// ----------------- Dimensiones del bitmap del corazón -----------------
const int CORAZON_WIDTH  = 128;
const int CORAZON_HEIGHT = 32;


// Posición centrada (se calcula sola según el tamaño del bitmap)
const int xOffset = (SCREEN_WIDTH  - CORAZON_WIDTH)  / 2;
const int yOffset = (SCREEN_HEIGHT - CORAZON_HEIGHT) / 2;


// ----------------- Bitmaps de la animación del corazón -----------------


// fotograma1corazon  128 x 32  (mono, SSD1306 vertical pages, LSB=top)
const int fotograma1corazon_width  = 128;
const int fotograma1corazon_height = 32;
const unsigned char fotograma1corazon[] PROGMEM = {
  0x00, 0x00, 0x00, 0x00, 0x00, 0x00, 0x00, 0x00, 0x00, 0x00, 0x00, 0x00, 0x00, 0x00, 0x00, 0x00,
  0x00, 0x00, 0x00, 0x00, 0x00, 0x00, 0x00, 0x00, 0x00, 0x00, 0x00, 0x00, 0x00, 0x00, 0x00, 0x00,
  0x00, 0x00, 0x00, 0x00, 0x00, 0x00, 0x00, 0x00, 0x00, 0x00, 0x00, 0x00, 0x00, 0x00, 0x00, 0x00,
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  0x00, 0x00, 0x00, 0x00, 0x00, 0x00, 0x00, 0x00, 0x00, 0x00, 0x00, 0x00, 0x00, 0x00, 0x00, 0x00
};


// fotograma2corazon  128 x 32  (mono, SSD1306 vertical pages, LSB=top)
const int fotograma2corazon_width  = 128;
const int fotograma2corazon_height = 32;
const unsigned char fotograma2corazon[] PROGMEM = {
  0x00, 0x00, 0x00, 0x00, 0x00, 0x00, 0x00, 0x00, 0x00, 0x00, 0x00, 0x00, 0x00, 0x00, 0x00, 0x00,
  0x00, 0x00, 0x00, 0x00, 0x00, 0x00, 0x00, 0x00, 0x00, 0x00, 0x00, 0x00, 0x00, 0x00, 0x00, 0x00,
  0x00, 0x00, 0x00, 0x00, 0x00, 0x00, 0x00, 0x00, 0x00, 0x00, 0x00, 0x00, 0x00, 0x00, 0x00, 0x00,
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  0x00, 0x00, 0x00, 0x00, 0x00, 0x00, 0x00, 0x00, 0x00, 0x00, 0x00, 0x00, 0x00, 0x00, 0x00, 0x00
};


// fotograma3corazon  128 x 32  (mono, SSD1306 vertical pages, LSB=top)
const int fotograma3corazon_width  = 128;
const int fotograma3corazon_height = 32;
const unsigned char fotograma3corazon[] PROGMEM = {
  0x00, 0x00, 0x00, 0x00, 0x00, 0x00, 0x00, 0x00, 0x00, 0x00, 0x00, 0x00, 0x00, 0x00, 0x00, 0x00,
  0x00, 0x00, 0x00, 0x00, 0x00, 0x00, 0x00, 0x00, 0x00, 0x00, 0x00, 0x00, 0x00, 0x00, 0x00, 0x00,
  0x00, 0x00, 0x00, 0x00, 0x00, 0x00, 0x00, 0x00, 0x00, 0x00, 0x00, 0x00, 0x00, 0x00, 0x00, 0x00,
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  0x00, 0x00, 0x00, 0x00, 0x00, 0x00, 0x00, 0x00, 0x00, 0x00, 0x00, 0x00, 0x00, 0x00, 0x00, 0x00
};


// Array de punteros para recorrer los frames fácilmente en el ciclo
const unsigned char* const animationFrames[TOTAL_FRAMES] = {
  fotograma1corazon, fotograma2corazon, fotograma3corazon
};


// ============================================================
//  Función para dibujar un bitmap en formato "página SSD1306"
//  (cada byte = 8 píxeles verticales, LSB = arriba), permitiendo
//  posicionarlo en cualquier (x, y) de la pantalla.
// ============================================================
void drawPageBitmap(const uint8_t* bitmap, int bmpWidth, int bmpHeight, int xPos, int yPos) {
  uint8_t pages = bmpHeight / 8;


  for (uint8_t page = 0; page < pages; page++) {
    for (int col = 0; col < bmpWidth; col++) {
      uint8_t byteData = pgm_read_byte(&bitmap[page * bmpWidth + col]);
      if (byteData == 0) continue; // optimización: columna vacía


      int screenX = col + xPos;
      if (screenX < 0 || screenX >= SCREEN_WIDTH) continue;


      for (uint8_t bit = 0; bit < 8; bit++) {
        if (byteData & (1 << bit)) {
          int screenY = page * 8 + bit + yPos;
          if (screenY < 0 || screenY >= SCREEN_HEIGHT) continue;
          display.drawPixel(screenX, screenY, SSD1306_WHITE);
        }
      }
    }
  }
}


// ----------------- Setup -----------------
void setup() {
  Serial.begin(115200);


  if (!display.begin(SSD1306_SWITCHCAPVCC, SCREEN_ADDRESS)) {
    Serial.println(F("Error: no se pudo inicializar la pantalla SSD1306"));
    while (true) {
      // Detener ejecución si falla la pantalla
    }
  }


  display.clearDisplay();
  display.display();
}


// ----------------- Loop -----------------
void loop() {
  unsigned long currentMillis = millis();


  // ---------- Actualizar el fotograma de animación ----------
  if (currentMillis - previousFrameMillis >= frameInterval) {
    previousFrameMillis = currentMillis;
    currentFrame = (currentFrame + 1) % TOTAL_FRAMES;
  }


  // ---------- Dibujar en pantalla (siempre en la misma posición) ----------
  display.clearDisplay();
  drawPageBitmap(animationFrames[currentFrame], CORAZON_WIDTH, CORAZON_HEIGHT, xOffset, yOffset);
  display.display();
}


