/* ============================================================
   PROYECTO DE TALLER - "Irse y no volver..."
   Fragmento del poema "Puerto adelante" de Alejandra Pizarnik.

   Componentes:
   - Pantalla OLED SSD1306 128x32 (I2C)
   - Potenciómetro B20K
   - Botón pulsador
   ============================================================ */

#include <SPI.h>
#include <Wire.h>
#include <Adafruit_GFX.h>
#include <Adafruit_SSD1306.h>

// ---------------- CONFIGURACIÓN DE PANTALLA ----------------
#define SCREEN_WIDTH 128
#define SCREEN_HEIGHT 32
#define OLED_RESET -1
#define SCREEN_ADDRESS 0x3C

Adafruit_SSD1306 display(SCREEN_WIDTH, SCREEN_HEIGHT, &Wire, OLED_RESET);

// ---------------- PINES ----------------
const int PIN_BOTON = 2;
const int PIN_POTENCIOMETRO = A0;

// ---------------- MODOS DE OPERACIÓN ----------------
enum ModoOperacion {
  MODO_POTENCIOMETRO,
  MODO_DEMO
};

ModoOperacion modoActual = MODO_POTENCIOMETRO;

// ---------------- CONTROL DE PÁGINAS ----------------
// 0: Irse
// 1: y
// 2: no
// 3: volver...
// 4: puerto adelante
// 5: autora
// 6: ilustración
const int NUM_PAGINAS = 7;

int paginaActual = -1;

// ---------------- TEXTOS ----------------
const char LINEA_IRSE[]    = "Irse";
const char LINEA_Y[]       = "y";
const char LINEA_NO[]      = "no";
const char LINEA_VOLVER[]  = "volver...";
const char LINEA_PUERTO[]  = "puerto adelante";
const char LINEA_AUTOR_1[] = "Alejandra Pizarnik";
const char LINEA_AUTOR_2[] = "";

// ---------------- ANIMACIÓN DEL BARCO ----------------
// ---------- Bitmaps ----------
// 'bmp-1', 128x32px
const unsigned char epd_bitmap_bmp_1 [] PROGMEM = {
	0x00, 0x00, 0x00, 0x00, 0x00, 0x00, 0x00, 0x00, 0x00, 0x00, 0x00, 0x00, 0x00, 0x00, 0x00, 0x00, 
	0x60, 0x00, 0x00, 0x00, 0x00, 0x00, 0x00, 0x00, 0x00, 0x00, 0x00, 0x00, 0x00, 0x00, 0x00, 0x00, 
	0x38, 0x00, 0x00, 0x00, 0x00, 0x00, 0x00, 0x00, 0x00, 0x00, 0x00, 0x00, 0x00, 0x00, 0x00, 0x00, 
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	0x00, 0x00, 0x00, 0x00, 0x00, 0x00, 0x00, 0x00, 0x00, 0x00, 0x00, 0x00, 0x00, 0x00, 0x00, 0x00
};
// 'bmp-2', 128x32px
const unsigned char epd_bitmap_bmp_2 [] PROGMEM = {
	0x00, 0x00, 0x00, 0x00, 0x00, 0x00, 0x00, 0x00, 0x00, 0x00, 0x00, 0x00, 0x00, 0x00, 0x00, 0x00, 
	0x00, 0x00, 0x00, 0x00, 0x03, 0x00, 0x00, 0x00, 0x00, 0x00, 0x00, 0x00, 0x00, 0x00, 0x00, 0x00, 
	0x00, 0x00, 0x00, 0x00, 0x01, 0xc0, 0x00, 0x00, 0x00, 0x00, 0x00, 0x00, 0x00, 0x00, 0x00, 0x00, 
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	0x00, 0x00, 0x00, 0x00, 0x00, 0x00, 0x00, 0x00, 0x00, 0x00, 0x00, 0x00, 0x00, 0x00, 0x00, 0x00
};
// 'bmp-3', 128x32px
const unsigned char epd_bitmap_bmp_3 [] PROGMEM = {
	0x00, 0x00, 0x00, 0x00, 0x00, 0x00, 0x00, 0x00, 0x00, 0x00, 0x00, 0x00, 0x00, 0x00, 0x00, 0x00, 
	0x00, 0x00, 0x00, 0x00, 0x00, 0x00, 0x00, 0x00, 0x00, 0x00, 0xc0, 0x00, 0x00, 0x00, 0x00, 0x00, 
	0x00, 0x00, 0x00, 0x00, 0x00, 0x00, 0x00, 0x00, 0x00, 0x00, 0x70, 0x00, 0x00, 0x00, 0x00, 0x00, 
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	0x00, 0x00, 0x00, 0x00, 0x00, 0x00, 0x00, 0x00, 0x00, 0x00, 0x00, 0x00, 0x00, 0x00, 0x00, 0x00
};
// 'bmp-4', 128x32px
const unsigned char epd_bitmap_bmp_4 [] PROGMEM = {
	0x00, 0x00, 0x00, 0x00, 0x00, 0x00, 0x00, 0x00, 0x00, 0x00, 0x00, 0x00, 0x00, 0x00, 0x00, 0x00, 
	0x00, 0x00, 0x00, 0x00, 0x00, 0x00, 0x00, 0x00, 0x00, 0x00, 0x00, 0x00, 0x00, 0x00, 0x00, 0x00, 
	0x00, 0x00, 0x00, 0x00, 0x00, 0x00, 0x00, 0x00, 0x00, 0x00, 0x00, 0x00, 0x00, 0x00, 0x0e, 0x00, 
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	0x00, 0x00, 0x00, 0x00, 0x00, 0x00, 0x00, 0x00, 0x00, 0x00, 0x00, 0x00, 0x00, 0x01, 0x80, 0x00
};


const int epd_bitmap_allArray_LEN = 4;
const unsigned char* epd_bitmap_allArray[4] = {
  epd_bitmap_bmp_1,
  epd_bitmap_bmp_2,
  epd_bitmap_bmp_3,
  epd_bitmap_bmp_4
};

const unsigned long FRAME_DELAY = 500;
int frameIndex = 0;
unsigned long ultimoFrame = 0;

// ---------------- DURACIÓN DEL MODO DEMO ----------------
const unsigned long DURACIONES_PAGINA[NUM_PAGINAS] = {
  900,    // Irse
  600,    // y
  700,    // no
  1200,   // volver...
  2200,   // puerto adelante
  2500,   // autora
  4000    // ilustración
};

// ---------------- POTENCIÓMETRO ----------------
int valorPotenciometro = 0;

// ---------------- BOTÓN / DEBOUNCE ----------------
bool estadoBotonActual = HIGH;
bool estadoBotonAnterior = HIGH;

unsigned long ultimoCambioBoton = 0;

const unsigned long TIEMPO_DEBOUNCE = 50;

// ---------------- MODO DEMO ----------------
unsigned long tiempoInicioPaginaDemo = 0;

// ---------------- TEXTO ----------------
const int TAMANO_TEXTO = 1;
const int ESPACIO_ENTRE_LINEAS = 12;

// ---------------- MOVIMIENTO DE OLAS DEL TEXTO ----------------
// Cada letra sube y baja suavemente, como si flotara sobre el mar.
unsigned long ultimoMovimientoTexto = 0;
const unsigned long VELOCIDAD_OLAS = 45;
float faseOlas = 0.0;

// ---------------- PROTOTIPOS ----------------
void leerBoton();
bool debounceBoton();
int determinarPaginaPorPotenciometro();
void actualizarModoDemo();
void mostrarPagina(int numeroPagina);
void dibujarTexto(
  const char* linea1,
  const char* linea2
) {
  display.clearDisplay();

  // La onda avanza lentamente con el tiempo.
  // Cada carácter recibe una fase diferente para formar una ola.
  float fase = faseOlas;

  // Dibujar primera línea
  int16_t x1, y1;
  uint16_t ancho1, alto1;

  display.setTextSize(TAMANO_TEXTO);
  display.getTextBounds(linea1, 0, 0, &x1, &y1, &ancho1, &alto1);

  int xInicio1 = (SCREEN_WIDTH - ancho1) / 2;
  if (xInicio1 < 0) xInicio1 = 0;

  int x = xInicio1;

  for (int i = 0; linea1[i] != '\0'; i++) {
    char letra[2] = { linea1[i], '\0' };

    int16_t bx, by;
    uint16_t bw, bh;
    display.getTextBounds(letra, 0, 0, &bx, &by, &bw, &bh);

    // Movimiento vertical sinusoidal.
    int desplazamiento = (int)(sin(fase + i * 0.65) * 2.5);

    int yBase;
    if (strlen(linea2) == 0) {
      yBase = 12;
    } else {
      yBase = 3;
    }

    display.setCursor(x, yBase + desplazamiento);
    display.print(letra);

    x += bw;
  }

  // Dibujar segunda línea si existe
  if (strlen(linea2) > 0) {
    int16_t x2, y2;
    uint16_t ancho2, alto2;

    display.getTextBounds(linea2, 0, 0, &x2, &y2, &ancho2, &alto2);

    int xInicio2 = (SCREEN_WIDTH - ancho2) / 2;
    if (xInicio2 < 0) xInicio2 = 0;

    x = xInicio2;

    for (int i = 0; linea2[i] != '\0'; i++) {
      char letra[2] = { linea2[i], '\0' };

      int16_t bx, by;
      uint16_t bw, bh;
      display.getTextBounds(letra, 0, 0, &bx, &by, &bw, &bh);

      int desplazamiento = (int)(sin(fase + i * 0.65 + 1.2) * 2.5);

      display.setCursor(x, 15 + desplazamiento);
      display.print(letra);

      x += bw;
    }
  }

  display.display();
}


// ============================================================
// SETUP
// ============================================================
void setup() {
  Serial.begin(9600);

  pinMode(PIN_BOTON, INPUT_PULLUP);
  pinMode(PIN_POTENCIOMETRO, INPUT);

  if (!display.begin(SSD1306_SWITCHCAPVCC, SCREEN_ADDRESS)) {
    Serial.println(F("Fallo al iniciar SSD1306"));
    for (;;);
  }

  display.clearDisplay();
  display.setTextColor(SSD1306_WHITE);
  display.setTextSize(TAMANO_TEXTO);

  paginaActual = determinarPaginaPorPotenciometro();
  mostrarPagina(paginaActual);
}

// ============================================================
// LOOP
// ============================================================
void loop() {
  leerBoton();

  if (modoActual == MODO_POTENCIOMETRO) {
    int nuevaPagina = determinarPaginaPorPotenciometro();

    if (nuevaPagina != paginaActual) {
      paginaActual = nuevaPagina;
      faseOlas = 0.0;
      mostrarPagina(paginaActual);
    }
  } else {
    actualizarModoDemo();
  }

  // Animar las letras solamente en las páginas de texto.
  if (paginaActual >= 0 && paginaActual <= 5) {
    if (millis() - ultimoMovimientoTexto >= VELOCIDAD_OLAS) {
      ultimoMovimientoTexto = millis();
      faseOlas += 0.22;

      switch (paginaActual) {
        case 0: dibujarTexto(LINEA_IRSE, ""); break;
        case 1: dibujarTexto(LINEA_Y, ""); break;
        case 2: dibujarTexto(LINEA_NO, ""); break;
        case 3: dibujarTexto(LINEA_VOLVER, ""); break;
        case 4: dibujarTexto(LINEA_PUERTO, ""); break;
        case 5: dibujarTexto(LINEA_AUTOR_1, LINEA_AUTOR_2); break;
      }
    }
  }

  // Animación del barco en la página 6.
  actualizarAnimacion();

  delay(5);
}

// ============================================================
// BOTÓN
// ============================================================
void leerBoton() {
  if (debounceBoton()) {
    if (modoActual == MODO_POTENCIOMETRO) {
      modoActual = MODO_DEMO;
      paginaActual = 0;
      faseOlas = 0.0;
      tiempoInicioPaginaDemo = millis();
      mostrarPagina(paginaActual);
    } else {
      modoActual = MODO_POTENCIOMETRO;
      paginaActual = determinarPaginaPorPotenciometro();
      faseOlas = 0.0;
      mostrarPagina(paginaActual);
    }
  }
}

// ============================================================
// DEBOUNCE DEL BOTÓN
// ============================================================
bool debounceBoton() {
  bool lectura = digitalRead(PIN_BOTON);
  bool pulsacionDetectada = false;

  if (lectura != estadoBotonAnterior) {
    ultimoCambioBoton = millis();
  }

  if ((millis() - ultimoCambioBoton) > TIEMPO_DEBOUNCE) {
    if (lectura != estadoBotonActual) {
      estadoBotonActual = lectura;

      if (estadoBotonActual == LOW) {
        pulsacionDetectada = true;
      }
    }
  }

  estadoBotonAnterior = lectura;
  return pulsacionDetectada;
}

// ============================================================
// POTENCIÓMETRO
// ============================================================
int determinarPaginaPorPotenciometro() {
  valorPotenciometro = analogRead(PIN_POTENCIOMETRO);

  long pagina = (long)valorPotenciometro * NUM_PAGINAS / 1024;

  return constrain((int)pagina, 0, NUM_PAGINAS - 1);
}

// ============================================================
// MODO DEMO
// ============================================================
void actualizarModoDemo() {
  if (millis() - tiempoInicioPaginaDemo >= DURACIONES_PAGINA[paginaActual]) {
    paginaActual++;

    if (paginaActual >= NUM_PAGINAS) {
      paginaActual = 0;
    }

    faseOlas = 0.0;
    mostrarPagina(paginaActual);
    tiempoInicioPaginaDemo = millis();
  }
}

// ============================================================
// MOSTRAR PÁGINA
// ============================================================
void mostrarPagina(int numeroPagina) {
  switch (numeroPagina) {
    case 0: dibujarTexto(LINEA_IRSE, ""); break;
    case 1: dibujarTexto(LINEA_Y, ""); break;
    case 2: dibujarTexto(LINEA_NO, ""); break;
    case 3: dibujarTexto(LINEA_VOLVER, ""); break;
    case 4: dibujarTexto(LINEA_PUERTO, ""); break;
    case 5: dibujarTexto(LINEA_AUTOR_1, LINEA_AUTOR_2); break;
    case 6:
      frameIndex = 0;
      ultimoFrame = millis();
      dibujarIlustracion();
      break;
  }
}

// ============================================================
// ILUSTRACIÓN / ANIMACIÓN DEL BARCO
// ============================================================

void dibujarIlustracion() {
  display.clearDisplay();
  display.drawBitmap(
    0,
    0,
    epd_bitmap_allArray[frameIndex],
    SCREEN_WIDTH,
    SCREEN_HEIGHT,
    SSD1306_WHITE
  );
  display.display();
}

// Cambia de frame sin bloquear el resto del programa.
void actualizarAnimacion() {
  if (paginaActual != 6) {
    return;
  }

  if (millis() - ultimoFrame >= FRAME_DELAY) {
    ultimoFrame = millis();

    frameIndex++;

    if (frameIndex >= epd_bitmap_allArray_LEN) {
      frameIndex = 0;
    }

    dibujarIlustracion();
  }
}